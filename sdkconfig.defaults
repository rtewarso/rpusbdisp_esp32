## sdkconfig.defaults
```kconfig
CONFIG_IDF_TARGET="esp32s3"
CONFIG_SPIRAM=n
CONFIG_SPIRAM_MODE_QUAD=y
CONFIG_ESP_DEFAULT_CPU_FREQ_MHZ_240=y
CONFIG_FREERTOS_HZ=1000

# TinyUSB - disable all built-in classes (we use custom class driver)
CONFIG_TINYUSB_CDC_ENABLED=n
CONFIG_TINYUSB_MSC_ENABLED=n
CONFIG_TINYUSB_HID_ENABLED=n
CONFIG_TINYUSB_MIDI_ENABLED=n
CONFIG_TINYUSB_VENDOR_ENABLED=n
# Route console to UART so USB-OTG port is free for TinyUSB device
CONFIG_ESP_CONSOLE_UART_DEFAULT=y
```
